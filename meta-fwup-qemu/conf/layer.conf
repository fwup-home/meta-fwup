## meta-fwup-qemu/conf/layer.conf
```bitbake
# We have a conf and classes directory, append to BBPATH 
BBPATH .= ":${LAYERDIR}"

# We have a recipes directory, add to BBFILES
BBFILES += "${LAYERDIR}/recipes-*/*/*.bb ${LAYERDIR}/recipes-*/*/*.bbappend"

BBFILE_COLLECTIONS += "fwup-qemu-layer"
BBFILE_PATTERN_fwup-qemu-layer := "^${LAYERDIR}/"
BBFILE_PRIORITY_fwup-qemu-layer = "9"

LAYERDEPENDS_fwup-qemu-layer = "core"
LAYERDEPENDS_fwup-qemu-layer += "fwup-qemu-layer"

LAYERSERIES_COMPAT_fwup-qemu-layer = "whinlatter"
```

## meta-fwup-qemu/wic/qemuarm-uboot-directdisk.wks
```
part /boot --source bootimg-partition --ondisk vda --fstype=vfat --label boot --active --align 4096
part / --source rootfs --ondisk vda --fstype=ext4 --label platform --align 4096
```

## meta-fwup-qemu/wic/qemux86-64-grub-efi.wks
```
bootloader --ptable gpt --configfile qemux86-64-grub-efi.cfg
part /boot --source bootimg-efi --sourceparams="loader=grub-efi" --ondisk vda --label msdos --active --align 1024
part / --source rootfs --ondisk vda --fstype=ext4 --label platform --align 1024 --use-uuid
```

## meta-fwup-raspberrypi/conf/layer.conf
```bitbake
# We have a conf and classes directory, append to BBPATH 
BBPATH .= ":${LAYERDIR}"

# We have a recipes directory, add to BBFILES
BBFILES += "${LAYERDIR}/recipes-*/*/*.bb ${LAYERDIR}/recipes-*/*/*.bbappend"

BBFILE_COLLECTIONS += "fwup-raspberrypi-layer"
BBFILE_PATTERN_fwup-raspberrypi-layer := "^${LAYERDIR}/"
BBFILE_PRIORITY_fwup-raspberrypi-layer = "8"

LAYERDEPENDS_fwup-raspberrypi-layer = "core"
LAYERDEPENDS_fwup-raspberrypi-layer += "fwup-raspberrypi-layer"

LAYERSERIES_COMPAT_fwup-raspberrypi-layer = "whinlatter"
```
